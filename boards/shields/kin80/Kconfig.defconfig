## boards/shields/kin80/Kconfig.defconfig
```kconfig
# Copyright (c) 2024 The ZMK Contributors
# SPDX-License-Identifier: MIT

if SHIELD_KIN80

config ZMK_KEYBOARD_NAME
    default "Kin80 BLE"

endif
```

## boards/shields/kin80/Kconfig.shield
```kconfig
 #
 # Copyright (c) 2024 The ZMK Contributors
 #
 # SPDX-License-Identifier: MIT
 #

config SHIELD_KIN80
    def_bool $(shields_list_contains,kin80)
```
